%- Settings generated by Component Wizard
%;**%>12 Component name %>60: %get(DeviceName,Text)
%;**                                                             %>12 RTOS Version %>60: %get(FreeRTOSVersion,Text)
%;**%>12 Classic CodeWarrior %>60: %get(IsClassicCW,Text)
%;**%>12 Disabled Interrupts in Startup %>60: %get(DisabledInterruptsInStartup,Text)
%;**%>12 Utility %>60: %get(Utility,Text)
%;**%>12 Application Task Tags %>60: %get(UseApplicationTaskTags,Text)
%;**%>12 Use Trace Facility %>60: %get(UseTraceFacility,Text)
%;**%>12 TraceHooks %>60: %get(UseTraceHooksGroup,Text)
%if %get(UseTraceHooksGroup, Bool) = 'yes'
%;**%>14 FreeRTOS Trace %>60: %get(FRTrace,Text)
%else %- UseTraceHooksGroup
%endif %- UseTraceHooksGroup
%;**%>12 Collect Runtime Statistics %>60: %get(CollectRuntimeStatisticsGroup,Text)
%if %get(CollectRuntimeStatisticsGroup, Bool) = 'yes'
%;**%>14 LDD %>60: %get(LDDRuntimeCounterGroup,Text)
%if %get(LDDRuntimeCounterGroup, Bool) = 'yes'
%;**%>16 Runtime Counter LDD %>60: %get(RuntimeCntrLDD,Text)
%else %- LDDRuntimeCounterGroup
%endif %- LDDRuntimeCounterGroup
%;**%>14 non-LDD %>60: %get(NonLDDRuntimeCounterGroup,Text)
%if %get(NonLDDRuntimeCounterGroup, Bool) = 'yes'
%;**%>16 Runtime Counter %>60: %get(RuntimeCntr,Text)
%else %- NonLDDRuntimeCounterGroup
%endif %- NonLDDRuntimeCounterGroup
%else %- CollectRuntimeStatisticsGroup
%endif %- CollectRuntimeStatisticsGroup
%;**%>12 Scheduler %>60: %get(SchedulerGroup,Text)
%;**%>14 ColdFire V1 %>60: %get(ColdFireV1CPUSpecific,Text)
%if %get(ColdFireV1CPUSpecific, Bool) = 'yes'
%;**%>16 CPU %>60: %get(FreeRTOSColdFireCPU,Text)
%;**%>16 SWI %>60: %get(ColdFireSWI,Text)
%else %- ColdFireV1CPUSpecific
%endif %- ColdFireV1CPUSpecific
%;**%>14 ColdFire V2 %>60: %get(ColdFireV2CPUSpecific,Text)
%if %get(ColdFireV2CPUSpecific, Bool) = 'yes'
%;**%>16 CPU %>60: %get(FreeRTOSColdFireV2CPU,Text)
%;**%>16 Library Lowest Interrupt Priority %>60: %get(ColdFireV2LibraryLowestInterruptPriority,Text)
%;**%>16 SWI Number %>60: %get(ColdFireV2SWInumber,Text)
%else %- ColdFireV2CPUSpecific
%endif %- ColdFireV2CPUSpecific
%;**%>14 Kinetis %>60: %get(KinetisCPUSpecific,Text)
%if %get(KinetisCPUSpecific, Bool) = 'yes'
%;**%>16 ARM Family %>60: %get(ARMFamilyType,Text)
%;**%>16 Floating Point Support %>60: %get(M4FFloatingPointSupport,Text)
%;**%>16 Lowest Interrupt Priority %>60: %get(ARMLowestInterrutpPriority,Text)
%;**%>16 Library Lowest Interrupt Priority %>60: %get(KinetisLibraryLowestInterruptPriority,Text)
%;**%>16 Max SysCall Interrupt Priority %>60: %get(KinetisLibraryMaxInterruptPriority,Text)
%;**%>16 Compiler Optimization Level %>60: %get(CompilerOptimizationLevel,Text)
%;**%>16 SysTick %>60: %get(useARMSysTickTimer,Text)
%else %- KinetisCPUSpecific
%endif %- KinetisCPUSpecific
%;**%>14 non-LDD SWI %>60: %get(NonLDDSWIGroup,Text)
%if %get(NonLDDSWIGroup, Bool) = 'yes'
%;**%>16 SWI %>60: %get(SWI,Text)
%else %- NonLDDSWIGroup
%endif %- NonLDDSWIGroup
%;**%>14 Preemptive %>60: %get(UsePreemption,Text)
%;**%>14 Use Co-Routines %>60: %get(UseCoroutines,Text)
%;**%>14 Idle should yield %>60: %get(IdleShouldYield,Text)
%;**%>14 Task Name Length %>60: %get(TaskNameLength,Text)
%;**%>14 Minimal Stack Size %>60: %get(MinimalStackSize,Text)
%;**%>14 Maximum Priorities %>60: %get(MaxPriority,Text)
%;**%>14 Maximum Coroutine Priorities %>60: %get(MaxCoroutinePriorities,Text)
%;**%>14 Stackoverflow checking method %>60: %get(StackOverflowCheckingMethodNumber,Text)
%;**%>14 Cleanup Resources %>60: %get(CleanupResources,Text)
%;**%>14 Tickless Idle Mode %>60: %get(TicklessIdleModeEnabled,Text)
%if %get(TicklessIdleModeEnabled, Bool) = 'yes'
%;**%>16 Stopped Timer Compensation %>60: %get(StoppedTimerCompensation,Text)
%;**%>16 Expected Idle Time (Ticks) before Sleep %>60: %get(ExpectedIdleTimeBeforeSleep,Text)
%else %- TicklessIdleModeEnabled
%endif %- TicklessIdleModeEnabled
%;**%>12 Ticks %>60: %get(TicksGroup,Text)
%;**%>14 Tick Rate (Hz) %>60: %get(TickRateHz,Text)
%;**%>14 Use 16bit ticks %>60: %get(Use16bitTicks,Text)
%;**%>14 non-LDD Tick %>60: %get(NonLDDTickGroup,Text)
%if %get(NonLDDTickGroup, Bool) = 'yes'
%;**%>16 Tick Counter %>60: %get(TickCntr,Text)
%else %- NonLDDTickGroup
%endif %- NonLDDTickGroup
%;**%>14 LDD Tick %>60: %get(LDDTickGroup,Text)
%if %get(LDDTickGroup, Bool) = 'yes'
%;**%>16 Tick Timer %>60: %get(TickTimerLDD,Text)
%else %- LDDTickGroup
%endif %- LDDTickGroup
%;**%>12 Queues %>60: %get(QueuesGroup,Text)
%;**%>14 Queue Registry Size %>60: %get(QueueRegistrySize,Text)
%;**%>14 Queue Sets %>60: %get(useQueueSets,Text)
%;**%>12 Semaphores and Mutexes %>60: %get(MutexGroup,Text)
%;**%>14 Use Mutexes %>60: %get(UseMutexes,Text)
%;**%>14 Use Recursive Mutexes %>60: %get(UseRecursiveMutexes,Text)
%;**%>12 Timers %>60: %get(TimersEnabled,Text)
%if %get(TimersEnabled, Bool) = 'yes'
%;**%>14 Priority %>60: %get(TimerTaskPriority,Text)
%;**%>14 Queue Length %>60: %get(TimerTaskQueueLength,Text)
%;**%>14 Stack Depth %>60: %get(TimerTaskStackDepth,Text)
%else %- TimersEnabled
%endif %- TimersEnabled
%;**%>12 Memory %>60: %get(MemoryGroup,Text)
%;**%>14 Memory Allocation Scheme %>60: %get(MemoryScheme,Text)
%;**%>14 User Heap Section %>60: %get(UserHeapSectionEnabled,Text)
%if %get(UserHeapSectionEnabled, Bool) = 'yes'
%;**%>16 Heap Section Name %>60: %get(HeapSectionName,Text)
%else %- UserHeapSectionEnabled
%endif %- UserHeapSectionEnabled
%;**%>14 Total Heap Size %>60: %get(TotalHeapSize,Text)
%;**%>12 Command Interpreter %>60: %get(CommandInterpreterEnabled,Text)
%if %get(CommandInterpreterEnabled, Bool) = 'yes'
%;**%>14 Output Buffer Size %>60: %get(CommandIntMaxOutputSize,Text)
%else %- CommandInterpreterEnabled
%endif %- CommandInterpreterEnabled
%;**%>12 Shell %>60: %get(ShellEnabled,Text)
%if %get(ShellEnabled, Bool) = 'yes'
%;**%>14 Shell %>60: %get(Shell,Text)
%else %- ShellEnabled
%endif %- ShellEnabled
