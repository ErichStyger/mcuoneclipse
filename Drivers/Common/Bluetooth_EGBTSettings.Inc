%- Settings generated by Component Wizard
%;**%>12 Component name %>60: %get(DeviceName,Text)
%;**                                                             %>12 Firmware %>60: %get(Firmware,Text)
%;**%>12 Response timeout (ms) %>60: %get(ResponseTimeoutMs,Text)
%;**%>12 CMD Pin %>60: %get(CMDEnabled,Text)
%if %get(CMDEnabled, Bool) = 'yes'
%;**%>14 CMD pin %>60: %get(CMD,Text)
%else %- CMDEnabled
%endif %- CMDEnabled
%;**%>12 Interfaces %>60: %get(Interfaces,Text)
%;**%>14 Utility %>60: %get(Utility,Text)
%;**%>14 Wait %>60: %get(Wait,Text)
%;**%>14 Serial %>60: %get(Serial,Text)
%;**%>12 Shell %>60: %get(ShellEnabled,Text)
%if %get(ShellEnabled, Bool) = 'yes'
%;**%>14 Shell %>60: %get(Shell,Text)
%else %- ShellEnabled
%endif %- ShellEnabled
