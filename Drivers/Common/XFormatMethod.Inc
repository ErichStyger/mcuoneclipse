%- AUTOREGENERATE If you remove this line, this file cannot be rewrited (by default)
%ifndef CommentLine
%{
%endif CommentLine
%;** ===================================================================
%include Common\GeneralMethod.inc (xformat)
%;**     Description :
%;**         Printf() like function using variable arguments
%include Common\GeneralParameters.inc(27)
%;**         myoutchar%Parmyoutchar %>27 - Function pointer to output one
%;** %>29 new character
%;**         arg%Pararg %>27 - Argument for the output function
%;**         Variable_1%ParVariable_1 %>27 - 
%;**         fmt%Parfmt %>27 - Format options for the list of parameters
%;**         openArgList%ParopenArgList %>27 - Open argument list
%;**     Returns     :
%;**         ---%RetVal %>27 - Error code
%include Common\GeneralDamage.inc
%;** ===================================================================
%ifndef CommentLine
%}
%endif CommentLine