%- Settings generated by Component Wizard
%;**%>12 Component name %>60: %get(DeviceName,Text)
%;**%>12 Tick Time (ms) %>60: %get(TickTimeMs,Text)
%;**%>12 RTOS %>60: %get(RTOSGroup,Text)
%if %get(RTOSGroup, Bool) = 'yes'
%;**%>14 RTOS %>60: %get(RTOS,Text)
%else %- RTOSGroup
%endif %- RTOSGroup
%;**%>12 Initialization %>60: %get(InitializationEnabled,Text)
%if %get(InitializationEnabled, Bool) = 'yes'
%;**%>14 Init in startup %>60: %get(InitInStartup,Text)
%;**%>14 Date %>60: %get(InitialDate,Text)
%;**%>14 Time %>60: %get(InitialTime,Text)
%else %- InitializationEnabled
%endif %- InitializationEnabled
