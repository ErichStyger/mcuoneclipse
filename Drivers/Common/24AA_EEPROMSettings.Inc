%- Settings generated by Component Wizard
%;**%>12 Component name %>60: %get(DeviceName,Text)
%;**%>12 Device %>60: %get(Device,Text)
%;**%>12 Initial Device Address %>60: %get(DeviceAddress,Text)
%;**%>12 Block buffer size %>60: %get(BlockBufSize,Text)
%;**%>12 Acknowledge Polling %>60: %get(DoAcknowledgePolling,Text)
%if %get(DoAcknowledgePolling, Bool) = 'yes'
%;**%>14 Page Write Time (ms) %>60: %get(PageWriteTimeMs,Text)
%;**%>14 Wait %>60: %get(Wait,Text)
%else %- DoAcknowledgePolling
%endif %- DoAcknowledgePolling
%;**%>12 Connection %>60: %get(ConnectionGroup,Text)
%;**%>14 I2C %>60: %get(I2C,Text)
%;**%>14 Write Protection Pin %>60: %get(WriteProtectionGroup,Text)
%if %get(WriteProtectionGroup, Bool) = 'yes'
%;**%>16 WP %>60: %get(WP,Text)
%else %- WriteProtectionGroup
%endif %- WriteProtectionGroup
%;**%>12 Timeout %>60: %get(TimeoutEnabled,Text)
%if %get(TimeoutEnabled, Bool) = 'yes'
%;**%>14 Timeout %>60: %get(Timeout,Text)
%;**%>14 Timeout Byte (ms) %>60: %get(timeoutByteMs,Text)
%;**%>14 Timeout Block (ms) %>60: %get(timeoutBlockMs,Text)
%else %- TimeoutEnabled
%endif %- TimeoutEnabled
%;**%>12 Shell %>60: %get(ShellEnabled,Text)
%if %get(ShellEnabled, Bool) = 'yes'
%;**%>14 Shell %>60: %get(Shell,Text)
%;**%>14 Utility %>60: %get(Utility,Text)
%else %- ShellEnabled
%endif %- ShellEnabled
