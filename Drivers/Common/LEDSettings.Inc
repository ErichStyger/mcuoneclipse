%- Settings generated by Component Wizard
%;**%>12 Component name %>60: %get(DeviceName,Text)
%;**%>12 Turned On with initialization %>60: %get(LEDonWithInitialization,Text)
%;**%>12 HW Interface %>60: %get(HWInterfaceGroup,Text)
%;**%>14 On/Off %>60: %get(OnOffenabled,Text)
%if %get(OnOffenabled, Bool) = 'yes'
%;**%>16 Pin %>60: %get(LEDPin,Text)
%else %- OnOffenabled
%endif %- OnOffenabled
%;**%>14 PWM %>60: %get(PWMenabled,Text)
%if %get(PWMenabled, Bool) = 'yes'
%;**%>16 PWM %>60: %get(PWMpin,Text)
%else %- PWMenabled
%endif %- PWMenabled
%;**%>14 High Value means ON %>60: %get(AnodeOnPortSide,Text)
%;**%>12 Shell %>60: %get(Symbol,Text)
%if %get(Symbol, Bool) = 'yes'
%;**%>14 Shell %>60: %get(Shell,Text)
%;**%>14 Utility %>60: %get(Utility,Text)
%else %- Symbol
%endif %- Symbol
