%- AUTOREGENERATE If you remove this line, this file cannot be rewrited (by default)
%ifndef CommentLine
%{
%endif CommentLine
%;** ===================================================================
%include Common\GeneralMethod.inc (Create)
%;**     Description :
%;**         Initializes a generic transparent rectangle space
%include Common\GeneralParameters.inc(27)
%;**       * parent%Parparent %>27 - Pointer to parent element
%;**       * space%Parspace %>27 - Pointer to widget
%;**         x%Parx %>27 - x position of check box
%;**         y%Pary %>27 - y position of check box
%;**         width%Parwidth %>27 - width of element, including text
%;**         height%Parheight %>27 - height of the element
%;**     Returns     :
%;**         ---%RetVal %>27 - Error code
%include Common\GeneralDamage.inc
%;** ===================================================================
%ifndef CommentLine
%}
%endif CommentLine