%- Settings generated by Component Wizard
%;**%>12 Component name %>60: %get(DeviceName,Text)
%;**%>12 Echo %>60: %get(EchoEnabled,Text)
%;**%>12 Prompt %>60: %get(Prompt,Text)
%;**%>12 Project Name %>60: %get(ProjectNameStr,Text)
%;**%>12 Silent Mode Prefix %>60: %get(SilentModePrefixChar,Text)
%;**%>12 Blocking Send %>60: %get(BlockingSend,Text)
%;**%>12 Status Colon Pos %>60: %get(StatusColonPos,Text)
%;**%>12 Help Semicolon Pos %>60: %get(HelpSemicolonPos,Text)
%;**%>12 Multi Command %>60: %get(MultiCommandEnabled,Text)
%if %get(MultiCommandEnabled, Bool) = 'yes'
%;**%>14 Length %>60: %get(MaxSubCommandStringSize,Text)
%;**%>14 Separator %>60: %get(MultiCmdSeparationChar,Text)
%else %- MultiCommandEnabled
%endif %- MultiCommandEnabled
%;**%>12 Utility %>60: %get(Utility,Text)
%;**%>12 Shell %>60: %get(Symbol,Text)
%;**%>14 LDD %>60: %get(LDDConsoleEnabled,Text)
%if %get(LDDConsoleEnabled, Bool) = 'yes'
%;**%>16 USB CDC %>60: %get(USBCDDEnabled,Text)
%if %get(USBCDDEnabled, Bool) = 'yes'
%;**%>18 USB CDC %>60: %get(USBCDC,Text)
%else %- USBCDDEnabled
%endif %- USBCDDEnabled
%;**%>16 Serial %>60: %get(SerialEnabled,Text)
%if %get(SerialEnabled, Bool) = 'yes'
%;**%>18 Serial %>60: %get(SerialLDD,Text)
%;**%>18 RX Buffer %>60: %get(RxBuffer,Text)
%else %- SerialEnabled
%endif %- SerialEnabled
%else %- LDDConsoleEnabled
%endif %- LDDConsoleEnabled
%;**%>14 non-LDD %>60: %get(ConsoleEnabled,Text)
%if %get(ConsoleEnabled, Bool) = 'yes'
%;**%>16 Serial %>60: %get(Serial,Text)
%else %- ConsoleEnabled
%endif %- ConsoleEnabled
%;**%>12 File System %>60: %get(FSenabled,Text)
%if %get(FSenabled, Bool) = 'yes'
%;**%>14 File print buffer size %>60: %get(FilePrintBufferSize,Text)
%;**%>14 File copy buffer size %>60: %get(FileCopyBufferSize,Text)
%;**%>14 File System %>60: %get(FS,Text)
%else %- FSenabled
%endif %- FSenabled
%;**%>12 RTOS %>60: %get(HasRTOS,Text)
%if %get(HasRTOS, Bool) = 'yes'
%;**%>14 Use dynamic heap %>60: %get(UseRTOSDynamicMemory,Text)
%;**%>14 Shell Serial Semaphore %>60: %get(ConsoleSempahore,Text)
%;**%>14 RTOS %>60: %get(RTOS,Text)
%else %- HasRTOS
%endif %- HasRTOS
%;**%>12 Time and Date %>60: %get(TimeDateEnabled,Text)
%if %get(TimeDateEnabled, Bool) = 'yes'
%;**%>14 SW RTC %>60: %get(SWRTCenabled,Text)
%if %get(SWRTCenabled, Bool) = 'yes'
%;**%>16 TimeDate %>60: %get(SWRTC,Text)
%else %- SWRTCenabled
%endif %- SWRTCenabled
%;**%>14 HW RTC %>60: %get(RTCEnabled,Text)
%if %get(RTCEnabled, Bool) = 'yes'
%;**%>16 RTC %>60: %get(HWRTC,Text)
%else %- RTCEnabled
%endif %- RTCEnabled
%else %- TimeDateEnabled
%endif %- TimeDateEnabled
