%- Settings generated by Component Wizard
%;**%>12 Component name %>60: %get(DeviceName,Text)
%;**%>12 Inverted PWM %>60: %get(invertedPWM,Text)
%;**%>12 Init PWM %>60: %get(InitPWM,Text)
%;**%>12 Min Pos PWM (us) %>60: %get(MinPWMvalueUs,Text)
%;**%>12 Max Pos PWM (us) %>60: %get(MaxPWMvalueUs,Text)
%;**%>12 PWM Period (us) %>60: %get(PWMPeriodUs,Text)
%;**%>12 System %>60: %get(SystemGroup,Text)
%;**%>14 Timed Move %>60: %get(TimedMoveEnabled,Text)
%if %get(TimedMoveEnabled, Bool) = 'yes'
%;**%>16 Trigger %>60: %get(Trigger,Text)
%else %- TimedMoveEnabled
%endif %- TimedMoveEnabled
%;**%>14 Shell %>60: %get(ShellEnabled,Text)
%if %get(ShellEnabled, Bool) = 'yes'
%;**%>16 Utility %>60: %get(Util,Text)
%;**%>16 Shell %>60: %get(Shell,Text)
%else %- ShellEnabled
%endif %- ShellEnabled
%;**%>14 PWM %>60: %get(PWM,Text)
