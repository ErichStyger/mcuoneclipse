%- Settings generated by Bean Wizard
%;**%>12 Bean name %>60: %get(DeviceName,Text)
%;**%>12 Width %>60: %get(Width,Text)
%;**%>12 Height %>60: %get(Height,Text)
%;**%>12 Bytes in rows %>60: %get(BytesInRows,Text)
%;**%>12 MSB first %>60: %get(MSBfirst,Text)
%;**%>12 Display invert %>60: %get(DisplayInvert,Text)
%;**%>12 Hardware %>60: %get(HardwareGroup,Text)
%;**%>14 SPI Interface %>60: %get(SPI,Text)
%;**%>14 Chip Select Pin %>60: %get(CS,Text)
%;**%>14 Reset Pin %>60: %get(Reset,Text)
%;**%>14 Data/Cmd Pin %>60: %get(DataCmdPin,Text)
%;**%>14 Busy Pin %>60: %get(BusyPin,Text)
%;**%>14 Enable Vcc Pin %>60: %get(EnVcc,Text)
%;**%>12 SYSTEM %>60: %get(SystemGroug,Text)
%;**%>14 Wait %>60: %get(Wait,Text)
