%- Settings generated by Component Wizard
%;**%>12 Component name %>60: %get(DeviceName,Text)
%;**%>12 Transceiver %>60: %get(TransceiverGroup,Text)
%;**%>14 Transceiver Type %>60: %get(TransceiverType,Text)
%;**%>14 nRF24L01+ %>60: %get(nRF24L01pEnabled,Text)
%if %get(nRF24L01pEnabled, Bool) = 'yes'
%;**%>16 nRF24L01+ %>60: %get(nRF24L01p,Text)
%;**%>16 Radio Channel %>60: %get(RadioChannel_nRF,Text)
%;**%>16 Data Rate %>60: %get(nRF24DataRate,Text)
%;**%>16 Payload Size %>60: %get(PayloadSize,Text)
%else %- nRF24L01pEnabled
%endif %- nRF24L01pEnabled
%;**%>14 SMAC %>60: %get(SMACEnabled,Text)
%if %get(SMACEnabled, Bool) = 'yes'
%;**%>16 Radio Channel %>60: %get(RadioChannel_SMAC,Text)
%;**%>16 Output Power %>60: %get(OutputPower_SMAC,Text)
%;**%>16 SMAC %>60: %get(SMAC,Text)
%else %- SMACEnabled
%endif %- SMACEnabled
%;**%>12 Network %>60: %get(NetworkGroup,Text)
%;**%>14 Short Address Size %>60: %get(ShortAddrSize,Text)
%;**%>14 Use ACK %>60: %get(UseACK,Text)
%;**%>12 Queues %>60: %get(QueuesGroup,Text)
%;**%>14 Rx Message Queue Size %>60: %get(NofRxQueueItems,Text)
%;**%>14 Tx Message Queue Size %>60: %get(NofTxQueueItems,Text)
%;**%>14 Message Queue Blocking Time (ms) %>60: %get(MsgQueuePutBlockTimeMs,Text)
%;**%>12 Send Retry Count %>60: %get(MsgSendRetryCount,Text)
%;**%>12 System %>60: %get(SystemGroup,Text)
%;**%>14 Utility %>60: %get(Utility,Text)
%;**%>14 RTOS %>60: %get(RTOS,Text)
%;**%>14 Shell %>60: %get(ShellEnabled,Text)
%if %get(ShellEnabled, Bool) = 'yes'
%;**%>16 Remote StdIO %>60: %get(RStdioEnabled,Text)
%if %get(RStdioEnabled, Bool) = 'yes'
%;**%>18 Queue length %>60: %get(RStdioQueueLength,Text)
%;**%>18 Queue Timeout (ms) %>60: %get(QueueTimeoutMs,Text)
%else %- RStdioEnabled
%endif %- RStdioEnabled
%;**%>16 Shell %>60: %get(Shell,Text)
%else %- ShellEnabled
%endif %- ShellEnabled
