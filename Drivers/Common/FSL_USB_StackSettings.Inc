%- Settings generated by Component Wizard
%;**%>12 Component name %>60: %get(DeviceName,Text)
%;**%>12 Freescale USB Stack Version %>60: %get(FSLUSBStackVersion,Text)
%;**%>12 USB %>60: %get(USBInit,Text)
%;**%>12 Device Class %>60: %get(USBDeviceClass,Text)
%;**%>12 CDC Device %>60: %get(CDCDeviceGroup,Text)
%if %get(CDCDeviceGroup, Bool) = 'yes'
%;**%>14 CDCDevice %>60: %get(CDCDevice,Text)
%else %- CDCDeviceGroup
%endif %- CDCDeviceGroup
%;**%>12 HID Keyboard Device %>60: %get(HIDKDeviceGroup,Text)
%if %get(HIDKDeviceGroup, Bool) = 'yes'
%;**%>14 HID Keyboard %>60: %get(HIDKDevice,Text)
%else %- HIDKDeviceGroup
%endif %- HIDKDeviceGroup
%;**%>12 MSD Host %>60: %get(MSDHostGroup,Text)
%if %get(MSDHostGroup, Bool) = 'yes'
%;**%>14 MSDHost %>60: %get(MSDHost,Text)
%else %- MSDHostGroup
%endif %- MSDHostGroup
%;**%>12 Call Init Method %>60: %get(CallInitMethod,Text)
