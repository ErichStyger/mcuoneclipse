%- Settings generated by Component Wizard
%;**%>12 Component name %>60: %get(DeviceName,Text)
%;**%>12 HW Interface %>60: %get(HWInterface,Text)
%;**%>14 LCD Type %>60: %get(LCDType,Text)
%;**%>14 LCD Lines %>60: %get(LCD_Nof_Lines,Text)
%;**%>14 Characters per Line %>60: %get(CharsPerLine,Text)
%;**%>14 Line Addresses %>60: %get(LineAddressesGroup,Text)
%;**%>16 Line 1 %>60: %get(Line1Address,Text)
%;**%>16 Line 2 %>60: %get(Line2Address,Text)
%;**%>16 Line 3 %>60: %get(Line3Address,Text)
%;**%>16 Line 4 %>60: %get(Line4Address,Text)
%;**%>14 LCD Enable Signal %>60: %get(Symbol,Text)
%if %get(Symbol, Bool) = 'yes'
%;**%>16 LCD Enable signal %>60: %get(LCD_ENABLE,Text)
%else %- Symbol
%endif %- Symbol
%;**%>14 Read from Display %>60: %get(ReadFromDisplay,Text)
%if %get(ReadFromDisplay, Bool) = 'yes'
%;**%>16 R/W signal %>60: %get(RW,Text)
%;**%>16 Check Busy Flag %>60: %get(CheckBusyFlag,Text)
%else %- ReadFromDisplay
%endif %- ReadFromDisplay
%;**%>14 Wait (us) %>60: %get(WaitDisplayUs,Text)
%;**%>14 E signal %>60: %get(EN,Text)
%;**%>14 E2 %>60: %get(E2Enabled,Text)
%if %get(E2Enabled, Bool) = 'yes'
%;**%>16 E2 signal %>60: %get(E2,Text)
%else %- E2Enabled
%endif %- E2Enabled
%;**%>14 RS signal %>60: %get(RS,Text)
%;**%>14 Data/Control Bus %>60: %get(DataControlBusGroup,Text)
%;**%>16 Data/Control Bus Width %>60: %get(DataBusWidth,Text)
%;**%>16 DB0..DB3 %>60: %get(DB0toDB3,Text)
%if %get(DB0toDB3, Bool) = 'yes'
%;**%>18 DB0 %>60: %get(DB0,Text)
%;**%>18 DB1 %>60: %get(DB1,Text)
%;**%>18 DB2 %>60: %get(DB2,Text)
%;**%>18 DB3 %>60: %get(DB3,Text)
%else %- DB0toDB3
%endif %- DB0toDB3
%;**%>16 DB4..DB7 %>60: %get(DB4toDB7,Text)
%if %get(DB4toDB7, Bool) = 'yes'
%;**%>18 DB4 %>60: %get(DB4,Text)
%;**%>18 DB5 %>60: %get(DB5,Text)
%;**%>18 DB6 %>60: %get(DB6,Text)
%;**%>18 DB7 %>60: %get(DB7,Text)
%else %- DB4toDB7
%endif %- DB4toDB7
%;**%>16 Bits/Byte Bus %>60: %get(BusGroup,Text)
%if %get(BusGroup, Bool) = 'yes'
%;**%>18 Data/Control Bus %>60: %get(DataBus,Text)
%else %- BusGroup
%endif %- BusGroup
%;**%>12 System Interface %>60: %get(SystemInterface,Text)
%;**%>14 Wait %>60: %get(Wait,Text)
