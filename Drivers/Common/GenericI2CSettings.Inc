%- Settings generated by Component Wizard
%;**%>12 Component name %>60: %get(DeviceName,Text)
%;**%>12 Write Buffer Size %>60: %get(WriteBufferSize,Text)
%;**%>12 non-LDD I2C %>60: %get(nonLDD_I2C_Group,Text)
%if %get(nonLDD_I2C_Group, Bool) = 'yes'
%;**%>14 I2C %>60: %get(I2C,Text)
%else %- nonLDD_I2C_Group
%endif %- nonLDD_I2C_Group
%;**%>12 LDD I2C %>60: %get(LDD_I2C_Group,Text)
%if %get(LDD_I2C_Group, Bool) = 'yes'
%;**%>14 I2C %>60: %get(LDD_I2C,Text)
%;**%>14 Timeout %>60: %get(TimeoutGroupEnabled,Text)
%if %get(TimeoutGroupEnabled, Bool) = 'yes'
%;**%>16 Timeout %>60: %get(Timeout,Text)
%;**%>16 us %>60: %get(TimeoutUs,Text)
%else %- TimeoutGroupEnabled
%endif %- TimeoutGroupEnabled
%else %- LDD_I2C_Group
%endif %- LDD_I2C_Group
%;**%>12 RTOS %>60: %get(RTOSGroupEnabled,Text)
%if %get(RTOSGroupEnabled, Bool) = 'yes'
%;**%>14 RTOS %>60: %get(RTOS,Text)
%;**%>14 Semaphore %>60: %get(UseSemaphore,Text)
%else %- RTOSGroupEnabled
%endif %- RTOSGroupEnabled
%;**%>12 Init() on startup %>60: %get(initOnStartup,Text)
