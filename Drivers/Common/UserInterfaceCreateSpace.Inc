%- AUTOREGENERATE If you remove this line, this file cannot be rewrited (by default)
%ifndef CommentLine
%{
%endif CommentLine
%;** ===================================================================
%include Common\GeneralMethod.inc (CreateSpace)
%;**     Description :
%;**         Initializes a generic tranparent rectangle space
%include Common\GeneralParameters.inc(27)
%;**       * window%Parwindow %>27 - Pointer to window structure
%;**       * space%Parspace %>27 - Pointer to space element
%;**         x%Parx %>27 - x position of window
%;**         y%Pary %>27 - y position of window
%;**         width%Parwidth %>27 - width of window
%;**         height%Parheight %>27 - 
%;**     Returns     :
%;**         ---%RetVal %>27 - Error code
%include Common\GeneralDamage.inc
%;** ===================================================================
%ifndef CommentLine
%}
%endif CommentLine