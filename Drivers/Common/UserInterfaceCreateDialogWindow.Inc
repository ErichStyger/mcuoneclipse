%- AUTOREGENERATE If you remove this line, this file cannot be rewrited (by default)
%ifndef CommentLine
%{
%endif CommentLine
%;** ===================================================================
%include Common\GeneralMethod.inc (CreateDialogWindow)
%;**     Description :
%;**         Initializes a window with default values
%include Common\GeneralParameters.inc(27)
%;**       * screen%Parscreen %>27 - Pointer to screen
%;**       * window%Parwindow %>27 - Pointer to window structure
%;**         bgColor%ParbgColor %>27 - background color to be used
%;**         x%Parx %>27 - x position of window
%;**         y%Pary %>27 - y position of window
%;**         width%Parwidth %>27 - width of window
%;**         height%Parheight %>27 - 
%;**     Returns     :
%;**         ---%RetVal %>27 - Error code
%include Common\GeneralDamage.inc
%;** ===================================================================
%ifndef CommentLine
%}
%endif CommentLine