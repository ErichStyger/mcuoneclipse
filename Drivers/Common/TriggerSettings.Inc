%- Settings generated by Component Wizard
%;**%>12 Component name %>60: %get(DeviceName,Text)
%;**%>12 Trigger Events %>60: %get(TriggerNameList,Text)
%;**%>12 Low Power %>60: %get(LowPowerEnabled,Text)
%if %get(LowPowerEnabled, Bool) = 'yes'
%;**%>14 Low Power %>60: %get(LowPower,Text)
%else %- LowPowerEnabled
%endif %- LowPowerEnabled
%;**%>12 TickPeriodMs %>60: %get(TickPeriodMs,Text)
%;**%>12 RTOS %>60: %get(RTOSGroup,Text)
%if %get(RTOSGroup, Bool) = 'yes'
%;**%>14 RTOS %>60: %get(RTOS,Text)
%else %- RTOSGroup
%endif %- RTOSGroup
%;**%>12 Initialize on Init %>60: %get(InitializeOnInit,Text)
