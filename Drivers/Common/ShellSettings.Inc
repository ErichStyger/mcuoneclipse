%- Settings generated by Component Wizard
%;**%>12 Component name %>60: %get(DeviceName,Text)
%;**%>12 Echo %>60: %get(EchoEnabled,Text)
%;**%>12 Prompt %>60: %get(Prompt,Text)
%;**%>12 Project Name %>60: %get(ProjectNameStr,Text)
%;**%>12 Silent Mode Prefix %>60: %get(SilentModePrefixChar,Text)
%;**%>12 Blocking Send %>60: %get(BlockingSend,Text)
%if %get(BlockingSend, Bool) = 'yes'
%;**%>14 Wait %>60: %get(Wait,Text)
%;**%>14 Wait Time (ms) %>60: %get(WaitTimeMs,Text)
%;**%>14 RTOS Wait %>60: %get(RTOSWait,Text)
%else %- BlockingSend
%endif %- BlockingSend
%;**%>12 Status Colon Pos %>60: %get(StatusColonPos,Text)
%;**%>12 Help Semicolon Pos %>60: %get(HelpSemicolonPos,Text)
%;**%>12 Multi Command %>60: %get(MultiCommandEnabled,Text)
%if %get(MultiCommandEnabled, Bool) = 'yes'
%;**%>14 Length %>60: %get(MaxSubCommandStringSize,Text)
%;**%>14 Separator %>60: %get(MultiCmdSeparationChar,Text)
%else %- MultiCommandEnabled
%endif %- MultiCommandEnabled
%;**%>12 Utility %>60: %get(Utility,Text)
%;**%>12 Default Serial %>60: %get(DefaultSerialEnabled,Text)
%if %get(DefaultSerialEnabled, Bool) = 'yes'
%;**%>14 Console Interface %>60: %get(Serial,Text)
%else %- DefaultSerialEnabled
%endif %- DefaultSerialEnabled
%;**%>12 Serial Semaphore %>60: %get(ConsoleSempahore,Text)
%;**%>12 Critical Section %>60: %get(CriticalSection,Text)
