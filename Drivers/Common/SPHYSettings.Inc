%- Settings generated by Component Wizard
%;**%>12 Component name %>60: %get(DeviceName,Text)
%;**%>12 Enable Interrupts in DataIndication() %>60: %get(EnableInterruptsInDataIndication,Text)
%;**%>12 Radio Buffer Size %>60: %get(RadioBufSize,Text)
%;**%>12 Promiscuous Mode %>60: %get(AllowPromiscuousMode,Text)
%;**%>12 OTAP enabled %>60: %get(OTAPenabled,Text)
%;**%>12 Low Power Wait %>60: %get(LowPowerWait,Text)
%;**%>12 Security %>60: %get(SecurityEnabled,Text)
%if %get(SecurityEnabled, Bool) = 'yes'
%;**%>14 Security Interface %>60: %get(SecurityInterface,Text)
%else %- SecurityEnabled
%endif %- SecurityEnabled
%;**%>12 MC13192 %>60: %get(MC13192,Text)
