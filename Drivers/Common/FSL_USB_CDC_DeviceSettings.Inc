%- Settings generated by Component Wizard
%;**%>12 Component name %>60: %get(DeviceName,Text)
%;**%>12 CPU %>60: %get(CPUDevice,Text)
%;**%>12 CDC Settings %>60: %get(USBCDCenabled,Text)
%if %get(USBCDCenabled, Bool) = 'yes'
%;**%>14 .inf ClassGuid %>60: %get(CdcClassGuidString,Text)
%;**%>14 .inf VID %>60: %get(CdcVidValue,Text)
%;**%>14 .inf PID %>60: %get(CdcPidValue,Text)
%;**%>14 .inf PRVDR %>60: %get(CdcPrvdrString,Text)
%;**%>14 .inf MFGNAME %>60: %get(CdcMfgNameString,Text)
%;**%>14 .inf DESCRIPTION %>60: %get(CdcDescriptionString,Text)
%;**%>14 .inf SERVICE %>60: %get(CdcServiceString,Text)
%;**%>14 Bus reported device %>60: %get(CdcBusReportedDeviceDescriptionString,Text)
%;**%>14 Bus reported vendor %>60: %get(CdcBusReportedVendorString,Text)
%else %- USBCDCenabled
%endif %- USBCDCenabled
%;**%>12 Send Buffer %>60: %get(TxBuffer,Text)
%;**%>12 Receive Buffer %>60: %get(RxBuffer,Text)
%;**%>12 Use Timeout %>60: %get(TimeoutEnabled,Text)
%if %get(TimeoutEnabled, Bool) = 'yes'
%;**%>14 Timeout %>60: %get(Timeout,Text)
%;**%>14 App Task Timeout (ms) %>60: %get(AppTaskTimeout,Text)
%else %- TimeoutEnabled
%endif %- TimeoutEnabled
