%- Settings generated by Component Wizard
%;**%>12 Component name %>60: %get(DeviceName,Text)
%;**%>12 Initialize in Init %>60: %get(InitializeInInit,Text)
%;**%>12 Wait %>60: %get(Wait,Text)
%;**%>12 HW Interface %>60: %get(HWInterfaceGroup,Text)
%;**%>14 Transceiver %>60: %get(TransceiverGroup,Text)
%;**%>16 Tranceiver Type %>60: %get(TransceiverType,Text)
%;**%>16 Single Port Mode %>60: %get(RFswitchMode,Text)
%;**%>16 CT Bias Enable %>60: %get(CTbiasEnable,Text)
%;**%>14 CE Pin %>60: %get(CE,Text)
%;**%>14 RESET Pin %>60: %get(RESET,Text)
%;**%>14 RTXEN Pin %>60: %get(RTXEN,Text)
%;**%>14 ATTN Pin %>60: %get(ATTN,Text)
%;**%>14 SPI %>60: %get(SPIgroup,Text)
%;**%>16 SW SPI %>60: %get(SWSPI_Enabled,Text)
%if %get(SWSPI_Enabled, Bool) = 'yes'
%;**%>18 SW SPI %>60: %get(SWSPI,Text)
%else %- SWSPI_Enabled
%endif %- SWSPI_Enabled
%;**%>16 HW SPI %>60: %get(HWSPI_Enabled,Text)
%if %get(HWSPI_Enabled, Bool) = 'yes'
%;**%>18 Baud Rate Mode %>60: %get(HWSPIBaudRateMode,Text)
%;**%>18 HW SPI %>60: %get(HWSPI,Text)
%else %- HWSPI_Enabled
%endif %- HWSPI_Enabled
%;**%>16 MISO High Impedance %>60: %get(MISOHighImpedance,Text)
%;**%>16 MISO Drive Strength %>60: %get(MISODriveStrength,Text)
%;**%>14 IRQ %>60: %get(IRQgroup,Text)
%;**%>16 Macros %>60: %get(IRQMacrosList,Text)
%;**%>16 IRQ Pin %>60: %get(IRQ,Text)
%;**%>16 IRQ Pullup %>60: %get(IRQpullUp,Text)
%;**%>16 IRQ Drive Strength %>60: %get(IRQDriveStrength,Text)
%;**%>14 CLKO %>60: %get(CLKOgroup,Text)
%;**%>16 Enable %>60: %get(CLKOenable,Text)
%;**%>16 Frequency %>60: %get(CLKOfrequency,Text)
%;**%>16 Trim bits %>60: %get(xtal_trim,Text)
%;**%>16 Toggle in Doze Mode %>60: %get(CLKOoutOnDoze,Text)
%;**%>16 Drive Strength %>60: %get(CLKODriveStrength,Text)
%;**%>14 GPIOs %>60: %get(GPIOenabled,Text)
%if %get(GPIOenabled, Bool) = 'yes'
%;**%>16 GPIO1-4 High Drive Strength %>60: %get(GPIO14DriveStrength,Text)
%;**%>16 GPIO5-7 High Drive Strength %>60: %get(GPIO567DriveStrength,Text)
%;**%>16 Alternative MCU interface %>60: %get(GPIOaltInterface,Text)
%;**%>16 GPIO1 as input %>60: %get(GPIO1input,Text)
%;**%>16 GPIO2 as input %>60: %get(GPIO2input,Text)
%;**%>16 GPIO3 as input %>60: %get(GPIO3input,Text)
%;**%>16 GPIO4 as input %>60: %get(GPIO4input,Text)
%;**%>16 GPIO5 as input %>60: %get(GPIO5input,Text)
%;**%>16 GPIO6 as input %>60: %get(GPIO6input,Text)
%;**%>16 GPIO7 as input %>60: %get(GPIO7input,Text)
%else %- GPIOenabled
%endif %- GPIOenabled
