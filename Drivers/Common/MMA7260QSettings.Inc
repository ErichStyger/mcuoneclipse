%- Settings generated by Component Wizard
%;**%>12 Component name %>60: %get(DeviceName,Text)
%;**%>12 HW Interface %>60: %get(HWInterface,Text)
%;**%>14 G Select %>60: %get(GSelectPinsConnected,Text)
%if %get(GSelectPinsConnected, Bool) = 'yes'
%;**%>16 G Select 1 Signal %>60: %get(Gselect1pin,Text)
%;**%>16 G Select 2 Signal %>60: %get(Gselect2pin,Text)
%else %- GSelectPinsConnected
%endif %- GSelectPinsConnected
%;**%>14 Sleep %>60: %get(SleepPinConnected,Text)
%if %get(SleepPinConnected, Bool) = 'yes'
%;**%>16 Sleep Signal %>60: %get(SleepPin,Text)
%;**%>16 Enabled in init %>60: %get(EnabledInInit,Text)
%;**%>16 Enable/Disable A/D %>60: %get(EnableDisableAD,Text)
%else %- SleepPinConnected
%endif %- SleepPinConnected
%;**%>14 A/D %>60: %get(ADgroup,Text)
%;**%>16 A/D Converter %>60: %get(AccelADC,Text)
%;**%>16 X channel %>60: %get(XChannel,Text)
%;**%>16 Y channel %>60: %get(YChannel,Text)
%;**%>16 Z channel %>60: %get(ZChannel,Text)
%;**%>12 Calibration %>60: %get(CalibrationGroup,Text)
%;**%>14 X offset %>60: %get(xCalibrationOffset,Text)
%;**%>14 X 1g value %>60: %get(x1gValue,Text)
%;**%>14 Y offset %>60: %get(yCalibrationOffset,Text)
%;**%>14 Y 1g value %>60: %get(y1gValue,Text)
%;**%>14 Z offset %>60: %get(zCalibrationOffset,Text)
%;**%>14 Z 1g value %>60: %get(z1gValue,Text)
%;**%>12 System %>60: %get(SystemGroup,Text)
%;**%>14 Wait %>60: %get(Wait,Text)
%;**%>12 Shell %>60: %get(ShellEnabled,Text)
%if %get(ShellEnabled, Bool) = 'yes'
%;**%>14 Utility %>60: %get(Utility,Text)
%;**%>14 Shell %>60: %get(Shell,Text)
%else %- ShellEnabled
%endif %- ShellEnabled
