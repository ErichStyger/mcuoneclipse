%- Settings generated by Component Wizard
%;**%>12 Component name %>60: %get(DeviceName,Text)
%;**%>12 Block size %>60: %get(BlockSize,Text)
%;**%>12 Cmd wait counter %>60: %get(CmdWaitCounter,Text)
%;**%>12 Wait Ready Timeout (ms) %>60: %get(WaitReadyMs,Text)
%;**%>12 Wait Cmd Timeout (ms) %>60: %get(WaitCmdMs,Text)
%;**%>12 Receive Block Timeout (ms) %>60: %get(WaitReadBlockMs,Text)
%;**%>12 Hardware %>60: %get(HardwareGroup,Text)
%;**%>14 SW SPI %>60: %get(SWSPIenabled,Text)
%if %get(SWSPIenabled, Bool) = 'yes'
%;**%>16 SPI %>60: %get(SPI,Text)
%else %- SWSPIenabled
%endif %- SWSPIenabled
%;**%>14 HW SPI %>60: %get(HWSPIenabled,Text)
%if %get(HWSPIenabled, Bool) = 'yes'
%;**%>16 Slow Baud Rate Mode %>60: %get(HWSlowBaudRateMode,Text)
%;**%>16 Fast Baud Rate Mode %>60: %get(HWFastBaudRateMode,Text)
%;**%>16 LDD HW SPI %>60: %get(LDD_HW_SPI_Enabled,Text)
%if %get(LDD_HW_SPI_Enabled, Bool) = 'yes'
%;**%>18 LDD HW SPI %>60: %get(LDDHWSPI,Text)
%else %- LDD_HW_SPI_Enabled
%endif %- LDD_HW_SPI_Enabled
%;**%>16 non-LDD HW SPI %>60: %get(nonLDD_HW_SPI_Enabled,Text)
%if %get(nonLDD_HW_SPI_Enabled, Bool) = 'yes'
%;**%>18 HW SPI %>60: %get(HWSPI,Text)
%else %- nonLDD_HW_SPI_Enabled
%endif %- nonLDD_HW_SPI_Enabled
%else %- HWSPIenabled
%endif %- HWSPIenabled
%;**%>14 SPI Read/Write Macros %>60: %get(SPI_Read_Write_Macros,Text)
%if %get(SPI_Read_Write_Macros, Bool) = 'yes'
%;**%>16 SPI Macros %>60: %get(SPIMacrosList,Text)
%else %- SPI_Read_Write_Macros
%endif %- SPI_Read_Write_Macros
%;**%>14 Activate SPI bus %>60: %get(ActivateSPIBus,Text)
%;**%>14 Slave Select %>60: %get(SlaveSelectEnabled,Text)
%if %get(SlaveSelectEnabled, Bool) = 'yes'
%;**%>16 LDD SS %>60: %get(LDD_SS_Group,Text)
%if %get(LDD_SS_Group, Bool) = 'yes'
%;**%>18 Slave Select Pin %>60: %get(LDDSS,Text)
%else %- LDD_SS_Group
%endif %- LDD_SS_Group
%;**%>16 non-LDD SS %>60: %get(nonLDD_SS_Group,Text)
%if %get(nonLDD_SS_Group, Bool) = 'yes'
%;**%>18 Slave Select pin %>60: %get(SS,Text)
%else %- nonLDD_SS_Group
%endif %- nonLDD_SS_Group
%else %- SlaveSelectEnabled
%endif %- SlaveSelectEnabled
%;**%>14 Activate %>60: %get(ActivateGroup,Text)
%if %get(ActivateGroup, Bool) = 'yes'
%;**%>16 LDD Activate %>60: %get(LDD_Activate_Group,Text)
%if %get(LDD_Activate_Group, Bool) = 'yes'
%;**%>18 Activate pin %>60: %get(LDDACT,Text)
%else %- LDD_Activate_Group
%endif %- LDD_Activate_Group
%;**%>16 non-LDD Activate %>60: %get(nonLDD_Activate_Grp,Text)
%if %get(nonLDD_Activate_Grp, Bool) = 'yes'
%;**%>18 Activate pin %>60: %get(ACT,Text)
%else %- nonLDD_Activate_Grp
%endif %- nonLDD_Activate_Grp
%else %- ActivateGroup
%endif %- ActivateGroup
%;**%>14 Card detection %>60: %get(CardDetectionGroup,Text)
%if %get(CardDetectionGroup, Bool) = 'yes'
%;**%>16 Card Detect is LOW active %>60: %get(CardDetectIsLow,Text)
%;**%>16 LDD CD %>60: %get(LDD_CD_Group,Text)
%if %get(LDD_CD_Group, Bool) = 'yes'
%;**%>18 Card detection pin %>60: %get(LDDCDI,Text)
%else %- LDD_CD_Group
%endif %- LDD_CD_Group
%;**%>16 non-LDD CD %>60: %get(nonLDD_CD_Group,Text)
%if %get(nonLDD_CD_Group, Bool) = 'yes'
%;**%>18 Card detection pin %>60: %get(CDI,Text)
%else %- nonLDD_CD_Group
%endif %- nonLDD_CD_Group
%else %- CardDetectionGroup
%endif %- CardDetectionGroup
%;**%>14 Write protection %>60: %get(WriteProtectGroup,Text)
%if %get(WriteProtectGroup, Bool) = 'yes'
%;**%>16 Write Protect is LOW active %>60: %get(WriteProtectIsLow,Text)
%;**%>16 LDD WP %>60: %get(LDD_WP_Group,Text)
%if %get(LDD_WP_Group, Bool) = 'yes'
%;**%>18 Write Protect Pin %>60: %get(LDDWP,Text)
%else %- LDD_WP_Group
%endif %- LDD_WP_Group
%;**%>16 non-LDD WP %>60: %get(nonLDD_WP_Group,Text)
%if %get(nonLDD_WP_Group, Bool) = 'yes'
%;**%>18 WP pin %>60: %get(WP,Text)
%else %- nonLDD_WP_Group
%endif %- nonLDD_WP_Group
%else %- WriteProtectGroup
%endif %- WriteProtectGroup
%;**%>12 System %>60: %get(SystemGroup,Text)
%;**%>14 Wait %>60: %get(Wait,Text)
%;**%>14 Timeout %>60: %get(Timeout,Text)
%;**%>14 RTOS %>60: %get(RTOSEnabled,Text)
%if %get(RTOSEnabled, Bool) = 'yes'
%;**%>16 RTOS %>60: %get(RTOS,Text)
%else %- RTOSEnabled
%endif %- RTOSEnabled
