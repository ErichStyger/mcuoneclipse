%- Settings generated by Component Wizard
%;**%>12 Component name %>60: %get(DeviceName,Text)
%;**%>12 Manual Clock Values %>60: %get(ManualClockValues,Text)
%if %get(ManualClockValues, Bool) = 'yes'
%;**%>14 CPU_BUS_CLK_HZ %>60: %get(CpuBusClkHz,Text)
%;**%>14 CPU_BUS_CLK_HZ_HIGH %>60: %get(CpuBusClkHzHigh,Text)
%;**%>14 CPU_BUS_CLK_HZ_LOW %>60: %get(CpuBusClkHzLow,Text)
%;**%>14 CPU_BUS_CLK_HZ_SLOW %>60: %get(CpuBusClkHzSlow,Text)
%else %- ManualClockValues
%endif %- ManualClockValues
%;**%>12 Delay100usFunction %>60: %get(Delay100usFunction,Text)
%;**%>12 RTOS %>60: %get(RTOSgroup,Text)
%if %get(RTOSgroup, Bool) = 'yes'
%;**%>14 RTOS %>60: %get(RTOS,Text)
%else %- RTOSgroup
%endif %- RTOSgroup
%;**%>12 Watchdog %>60: %get(WatchdogEnabled,Text)
%if %get(WatchdogEnabled, Bool) = 'yes'
%;**%>14 Watchdog %>60: %get(Watchdog,Text)
%else %- WatchdogEnabled
%endif %- WatchdogEnabled
