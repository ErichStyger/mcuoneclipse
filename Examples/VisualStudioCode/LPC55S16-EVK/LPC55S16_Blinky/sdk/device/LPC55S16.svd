# LPC55S16 register map
Vendor: nxp.com; File version: 1.0
LPC55S16JBD100,LPC55S16JBD64,LPC55S16JEV59,LPC55S16JEV98
CPU: CM33 r2p0, little endian, MPU, FPU, VTOR, 3 interrupt priority bits
Registers are 32-bit, read-write, reset 0x0 unless marked. A register's access mark holds for its fields unless they carry their own. Offsets are from the block's base; lines under a group give offsets from that group; [hi:lo] are bit positions; {n}, {i} and the like mark numbered series; 'fields as' and 'values as' point back to an identical list; <NAME> marks a mode.

## Memory map
0x0003DE00 FLASH_CFPA_SCRATCH size 0x200 — FLASH_CFPA
0x0003E000 FLASH_CFPA0 size 0x200 — FLASH_CFPA
0x0003E200 FLASH_CFPA1 size 0x200 — FLASH_CFPA
0x0003E400 FLASH_CMPA size 0x200
0x0003E600 FLASH_KEY_STORE size 0x600
0x0003EC00 FLASH_ROMPATCH size 0x400
0x0003FC00 FLASH_NMPA size 0xCC0
0x40000000 SYSCON size 0x1000
0x40001000 IOCON size 0x100 — I/O pin configuration (IOCON)
0x40002000 GINT0 size 0x48 — Group GPIO input interrupt (GINT0/1)
0x40003000 GINT1 size 0x48 — Group GPIO input interrupt (GINT0/1)
0x40004000 PINT size 0x34 — Pin interrupt and pattern match (PINT)
0x40005000 SECPINT size 0x34 — Pin interrupt and pattern match (PINT)
0x40006000 INPUTMUX size 0x7B4 — Input multiplexing (INPUT MUX)
0x40008000 CTIMER0 size 0x88 — Standard counter/timers (CTIMER0 to 4)
0x40009000 CTIMER1 size 0x88 — Standard counter/timers (CTIMER0 to 4)
0x4000C000 WWDT size 0x1C — Windowed Watchdog Timer (WWDT)
0x4000D000 MRT0 size 0xFC — Multi-Rate Timer (MRT)
0x4000E000 UTICK0 size 0x20 — Micro-tick Timer (UTICK)
0x40013000 ANACTRL size 0x108 — ANALOGCTRL
0x40020000 PMC size 0xD8
0x40023000 SYSCTL size 0x190 — system controller
0x40028000 CTIMER2 size 0x88 — Standard counter/timers (CTIMER0 to 4)
0x40029000 CTIMER3 size 0x88 — Standard counter/timers (CTIMER0 to 4)
0x4002A000 CTIMER4 size 0x88 — Standard counter/timers (CTIMER0 to 4)
0x4002C000 RTC size 0x60 — Real-Time Clock (RTC)
0x4002D000 OSTIMER size 0x20 — Synchronous OS/Event timer with Wakeup Timer
0x40034000 FLASH size 0x1000
0x40035000 PRINCE size 0x94
0x40038000 USBPHY size 0x110 — Universal System Bus Physical Layer
0x4003A000 RNG size 0x1000
0x4003B000 PUF size 0x25C — PUFCTRL
0x4003B000 PUF_SRAM_CTRL size 0x3F0 — PUF SRAM Control
0x4003D000 PLU size 0xC20 — LPC80X Programmable Logic Unit (PLU)
0x40082000 DMA0 size 0x56C — DMA controller
0x40084000 USB0 size 0x38 — USB 2.0 Device Controller
0x40085000 SCT0 size 0x550 — SCTimer/PWM (SCT)
0x40086000 FLEXCOMM0 size 0x1000 — Flexcomm serial communication
0x40086000 I2C0 size 0x1000 — I2C-bus interfaces
0x40086000 I2S0 size 0x1000 — I2S interface
0x40086000 SPI0 size 0x1000 — Serial Peripheral Interfaces (SPI)
0x40086000 USART0 size 0x1000 — USARTs
0x40087000 FLEXCOMM1 size 0x1000 — Flexcomm serial communication
0x40087000 I2C1 size 0x1000 — I2C-bus interfaces
0x40087000 I2S1 size 0x1000 — I2S interface
0x40087000 SPI1 size 0x1000 — Serial Peripheral Interfaces (SPI)
0x40087000 USART1 size 0x1000 — USARTs
0x40088000 FLEXCOMM2 size 0x1000 — Flexcomm serial communication
0x40088000 I2C2 size 0x1000 — I2C-bus interfaces
0x40088000 I2S2 size 0x1000 — I2S interface
0x40088000 SPI2 size 0x1000 — Serial Peripheral Interfaces (SPI)
0x40088000 USART2 size 0x1000 — USARTs
0x40089000 FLEXCOMM3 size 0x1000 — Flexcomm serial communication
0x40089000 I2C3 size 0x1000 — I2C-bus interfaces
0x40089000 I2S3 size 0x1000 — I2S interface
0x40089000 SPI3 size 0x1000 — Serial Peripheral Interfaces (SPI)
0x40089000 USART3 size 0x1000 — USARTs
0x4008A000 FLEXCOMM4 size 0x1000 — Flexcomm serial communication
0x4008A000 I2C4 size 0x1000 — I2C-bus interfaces
0x4008A000 I2S4 size 0x1000 — I2S interface
0x4008A000 SPI4 size 0x1000 — Serial Peripheral Interfaces (SPI)
0x4008A000 USART4 size 0x1000 — USARTs
0x4008C000 GPIO size 0x2488 — General Purpose I/O (GPIO)
0x40094000 USBHSD size 0x38 — USB1 High-speed Device Controller
0x40095000 CRC_ENGINE size 0xC
0x40096000 FLEXCOMM5 size 0x1000 — Flexcomm serial communication
0x40096000 I2C5 size 0x1000 — I2C-bus interfaces
0x40096000 I2S5 size 0x1000 — I2S interface
0x40096000 SPI5 size 0x1000 — Serial Peripheral Interfaces (SPI)
0x40096000 USART5 size 0x1000 — USARTs
0x40097000 FLEXCOMM6 size 0x1000 — Flexcomm serial communication
0x40097000 I2C6 size 0x1000 — I2C-bus interfaces
0x40097000 I2S6 size 0x1000 — I2S interface
0x40097000 SPI6 size 0x1000 — Serial Peripheral Interfaces (SPI)
0x40097000 USART6 size 0x1000 — USARTs
0x40098000 FLEXCOMM7 size 0x1000 — Flexcomm serial communication
0x40098000 I2C7 size 0x1000 — I2C-bus interfaces
0x40098000 I2S7 size 0x1000 — I2S interface
0x40098000 SPI7 size 0x1000 — Serial Peripheral Interfaces (SPI)
0x40098000 USART7 size 0x1000 — USARTs
0x4009C000 DBGMAILBOX size 0x100 — MCU Debugger Mailbox
0x4009D000 CAN0 size 0x604 — Controller Area Network Flexible Data (CAN FD)
0x4009F000 FLEXCOMM8 size 0x1000 — Flexcomm serial communication
0x4009F000 SPI8 size 0x1000 — Serial Peripheral Interfaces (SPI)
0x400A0000 ADC0 size 0x584 — ADC
0x400A1000 CDOG size 0x4C
0x400A2000 USBFSH size 0x60 — USB0 Full-speed Host controller
0x400A3000 USBHSH size 0x54 — USB1 High-speed Host Controller
0x400A4000 HASHCRYPT size 0xDC — Hash-Crypt peripheral
0x400A5000 CASPER size 0x84
0x400A7000 DMA1 size 0x49C — DMA controller
0x400A8000 SECGPIO size 0x2484 — General Purpose I/O (GPIO)
0x400AC000 AHB_SECURE_CTRL size 0x1000 — AHB secure controller
0xE000E000 SCnSCB size 0x10
0xE000E100 NVIC size 0xE04
0xE000ED00 SCB size 0x90
0xE000ED90 MPU size 0x40 — Memory Protection Unit
0xE000EDD0 SAU size 0xEC

## Interrupts
0 WDT_BOD (WWDT)
1 DMA0
2 GINT0
3 GINT1
4 PIN_INT0 (PINT)
5 PIN_INT1 (PINT)
6 PIN_INT2 (PINT)
7 PIN_INT3 (PINT)
8 UTICK0
9 MRT0
10 CTIMER0
11 CTIMER1
12 SCT0
13 CTIMER3
{n+14} FLEXCOMM{n} (FLEXCOMM{n}, I2C{n}, I2S{n}, SPI{n}, USART{n}) (n=0..7)
22 ADC0
24 ACMP (PMC)
27 USB0_NEEDCLK (USB0, USBFSH)
28 USB0 (USB0, USBFSH)
29 RTC
32 PIN_INT4 (PINT)
33 PIN_INT5 (PINT)
34 PIN_INT6 (PINT)
35 PIN_INT7 (PINT)
36 CTIMER2
37 CTIMER4
38 OS_EVENT (OSTIMER)
43 CAN0_IRQ0 (CAN0)
44 CAN0_IRQ1 (CAN0)
46 USB1_PHY (USBPHY)
47 USB1 (USBHSD, USBHSH)
48 USB1_NEEDCLK (USBHSD, USBHSH)
49 SEC_HYPERVISOR_CALL (SECPINT)
50 SEC_GPIO_INT0_IRQ0 (SECPINT)
51 SEC_GPIO_INT0_IRQ1 (SECPINT)
52 PLU
53 SEC_VIO (SECPINT)
54 HASHCRYPT
55 CASER (CASPER)
56 PUF
58 DMA1
59 FLEXCOMM8 (FLEXCOMM8, SPI8)
60 CDOG

## Licence text in the file
Copyright 2016-2022 NXP All rights reserved. SPDX-License-Identifier: BSD-3-Clause
