/**
 * \file
 * \brief Interface to the speaker on the PRG_G board.
 * \author Erich Styger, erich.styger@hslu.ch
 *
 * This module implements to functions to use the speaker.
 */

#include "Platform.h"
#include "Speaker.h"
#include "DAC.h"
#include "McuWait.h"

#define SINE_TABLE_DIVISOR  (16)
  /*!< Reduction factor for sine table, to simplify things and not add too much waiting overhead */

/* http://www.daycounter.com/Calculators/Sine-Generator-Calculator.phtml
 * max 3300, 256 values */
static const uint16_t sinTable[] = {
  0x672,0x69a,0x6c3,0x6eb,0x714,0x73c,0x764,0x78c,
  0x7b4,0x7dc,0x803,0x82a,0x851,0x878,0x89e,0x8c4,
  0x8e9,0x90f,0x933,0x958,0x97c,0x99f,0x9c2,0x9e5,
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  0x530,0x558,0x580,0x5a8,0x5d0,0x5f9,0x621,0x64a
};


void SPEAKER_Play(uint32_t freqHz, uint32_t timeMs) {
  uint32_t iterations, usDelay, nofValues;
  unsigned int i;

  /* speaker frequency range: 400 Hz - 20 kHz */
  nofValues = sizeof(sinTable)/sizeof(sinTable[0])/SINE_TABLE_DIVISOR; /* only using a portion of the values in th sine table */
  iterations = (timeMs*freqHz)/1000;
  usDelay = ((1000*1000)/freqHz)/nofValues; /* delay after each value */
  DAC_Start();
  while (iterations>0) {
    for(i=0;i<sizeof(sinTable)/sizeof(sinTable[0]);i+=SINE_TABLE_DIVISOR) { /* go through one sine wave */
      DAC_SetMilliVolt(sinTable[i]);
      McuWait_Waitus(usDelay);
    }
    iterations--;
  }
  DAC_SetMilliVolt(0);
  DAC_Stop();
}

/*! struct to hold data for the speaker waveform */
struct {
  bool isPlaying;
  uint32_t frequencyHz;
  uint32_t delayUs;
  uint32_t sineIdx;
} SPEAKER_IsrData;

void SPEAKER_OnInterrupt(void) {
	if (SPEAKER_IsrData.isPlaying) {
		DAC_SetMilliVolt(sinTable[SPEAKER_IsrData.sineIdx]);
	      McuWait_Waitus(50);
		SPEAKER_IsrData.sineIdx += SINE_TABLE_DIVISOR;
		if (SPEAKER_IsrData.sineIdx>=sizeof(sinTable)/sizeof(sinTable[0])) {
			SPEAKER_IsrData.sineIdx = 0; /* restart */
		}
	}
}

void SPEAKER_StartPlaying(uint32_t freqHz) {
	uint32_t nofValues;

	SPEAKER_IsrData.sineIdx = 0;
	SPEAKER_IsrData.frequencyHz = freqHz;
	nofValues = sizeof(sinTable)/sizeof(sinTable[0])/SINE_TABLE_DIVISOR; /* only using a portion of the values in the sine table */
	SPEAKER_IsrData.delayUs = ((1000*1000)/freqHz)/nofValues; /* delay after each value */
	SPEAKER_IsrData.isPlaying = TRUE;
	DAC_Start();
}

void SPEAKER_StopPlaying(void) {
	SPEAKER_IsrData.isPlaying = FALSE;
	DAC_SetMilliVolt(0);
	DAC_Stop();
}


void SPEAKER_Init(void) {
	SPEAKER_IsrData.isPlaying = FALSE;
}
