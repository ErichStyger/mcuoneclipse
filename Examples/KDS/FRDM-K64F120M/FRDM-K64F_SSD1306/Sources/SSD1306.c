/*
 * SSD1306.c
 *
 *  Created on: 06.09.2017
 *      Author: Dic
 */

#include "SSD1306.h"
#include "GI2C1.h"
#if SSD1306_HAS_RST
  #include "RST.h"
#endif

static uint8_t actCol = 0;
static uint8_t actPage = 0;

/** Thin 5x8 font. */
static unsigned char font[] = {

    0x0,  0x0,  0x0,  0x0,  0x0,  0x0,    // [0x20] ' '
    0x0,  0x0,  0x2F,  0x0,  0x0,  0x0,    // [0x21] '!'
    0x0,  0x3,  0x0,  0x3,  0x0,  0x0,    // [0x22] '"'
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    0x0,  0x0,  0x0,  0x0,  0x0,  0x0,    // [0x8B] ''
};

#define SSD1306_CMD_REG		0x00
#define SSD1306_DATA_REG	0x40

#define SSD1306_SET_CONTRAST 0x81
#define SSD1306_DISPLAY_ALL_ON_RESUME 0xA4
#define SSD1306_DISPLAY_ALL_ON 0xA5
#define SSD1306_NORMAL_DISPLAY 0xA6
#define SSD1306_INVERT_DISPLAY 0xA7
#define SSD1306_DISPLAY_OFF 0xAE
#define SSD1306_DISPLAY_ON 0xAF

#define SSD1306_SET_DISPLAY_OFFSET 0xD3
#define SSD1306_SET_COM_PINS 0xDA

#define SSD1306_SET_VCOM_DETECT 0xDB

#define SSD1306_SET_DISPLAY_CLOCK_DIV 0xD5
#define SSD1306_SET_PRECHARGE 0xD9

#define SSD1306_SET_MULTIPLEX 0xA8

#define SSD1306_SET_LOW_COLUMN 0x00
#define SSD1306_SET_HIGH_COLUMN 0x10

#define SSD1306_SET_START_LINE 0x40

#define SSD1306_MEMORY_MODE 0x20
#define SSD1306_COLUMN_ADDR 0x21
#define SSD1306_PAGE_ADDR   0x22

#define SSD1306_COM_SCAN_INC 0xC0
#define SSD1306_COM_SCAN_DEC 0xC8

#define SSD1306_SEG_REMAP 0xA0

#define SSD1306_CHARGE_PUMP 0x8D

#define SSD1306_EXTERNAL_VCC 0x1
#define SSD1306_SWITCH_CAP_VCC 0x2

// Scrolling #defines
#define SSD1306_ACTIVATE_SCROLL 0x2F
#define SSD1306_DEACTIVATE_SCROLL 0x2E
#define SSD1306_SET_VERTICAL_SCROLL_AREA 0xA3
#define SSD1306_RIGHT_HORIZONTAL_SCROLL 0x26
#define SSD1306_LEFT_HORIZONTAL_SCROLL 0x27
#define SSD1306_VERTICAL_AND_RIGHT_HORIZONTAL_SCROLL 0x29
#define SSD1306_VERTICAL_AND_LEFT_HORIZONTAL_SCROLL 0x2A

#ifdef SSD1306_128X64
  #define SSD1306_LCDWIDTH                  128
  #define SSD1306_LCDHEIGHT                 64
#endif
#ifdef SSD1306_128X32
  #define SSD1306_LCDWIDTH                  128
  #define SSD1306_LCDHEIGHT                 32
#endif

#ifdef SSD1306_128X64
  #define SSD1306_DISPLAY_HW_NOF_COLUMNS	128u /* number of columns in hardware */
  #define SSD1306_DISPLAY_HW_NOF_ROWS     64u /* number of rows in hardware */
  #define SSD1306_DISPLAY_HW_NOF_PAGES	8u
#elif SSD1306_128x32
  #define SSD1306_DISPLAY_HW_NOF_COLUMNS	128u /* number of columns in hardware */
  #define SSD1306_DISPLAY_HW_NOF_ROWS     32u /* number of rows in hardware */
  #define SSD1306_DISPLAY_HW_NOF_PAGES	4u
#endif

void SSD1306_WriteCommand(uint8_t cmd) {
	GI2C1_WriteByteAddress8(SSD1306_I2C_ADDR, SSD1306_CMD_REG, cmd);
}

void SSD1306_WriteData(uint8_t data) {
	GI2C1_WriteByteAddress8(SSD1306_I2C_ADDR, SSD1306_DATA_REG, data);
}

void SSD1306_Init(void) {
	GI2C1_Init();
#if SSD1306_HAS_RST
	RST_ClrVal();
	WAIT1_Waitms(1);
	RST_SetVal();
#endif

	SSD1306_WriteCommand(SSD1306_DISPLAY_OFF);				// turn of display
	SSD1306_WriteCommand(SSD1306_SET_DISPLAY_CLOCK_DIV);	// set display clock divide ratio/oscillator frequency
	SSD1306_WriteCommand(0x80);								// the suggested ratio 0x80

	SSD1306_WriteCommand(SSD1306_SET_MULTIPLEX);			// set multiplex ratio(1 to 64)
#ifdef SSD1306_128X64
	SSD1306_WriteCommand(0x3F);								// the suggested 1/64 duty
#else
	SSD1306_WriteCommand(0x1F);
#endif

	SSD1306_WriteCommand(SSD1306_SET_DISPLAY_OFFSET);		// set display offset
	SSD1306_WriteCommand(0x00);								// no offset
	SSD1306_WriteCommand(SSD1306_SET_START_LINE | 0x00);	// set start line address

	SSD1306_WriteCommand(SSD1306_COLUMN_ADDR);				// set start and end address of the columns
	SSD1306_WriteCommand(0);
	SSD1306_WriteCommand(SSD1306_DISPLAY_HW_NOF_COLUMNS-1);

	SSD1306_WriteCommand(SSD1306_PAGE_ADDR);				// set start and end address of the pages
	SSD1306_WriteCommand(0);
	SSD1306_WriteCommand(SSD1306_DISPLAY_HW_NOF_PAGES-1);

	SSD1306_WriteCommand(SSD1306_CHARGE_PUMP);				// set charge pump enable/disable
#if SSD1306_EXTERNAL == 1
	SSD1306_WriteCommand(0x10);								// set to disabled
#else
	SSD1306_WriteCommand(0x14);								// set to enabled
#endif

	SSD1306_WriteCommand(SSD1306_MEMORY_MODE);				// set memory mode
	SSD1306_WriteCommand(0x00);

	SSD1306_WriteCommand(SSD1306_SEG_REMAP | 0x01);			// set segment re-map 128 to 0
	SSD1306_WriteCommand(SSD1306_COM_SCAN_DEC);				// set COM output scan direction 64 to 0
	SSD1306_WriteCommand(SSD1306_SET_COM_PINS);				// set COM pins hardware configuration
#ifdef SSD1306_128X64
	SSD1306_WriteCommand(0x12);								// the suggested 1/64 duty
#else
	SSD1306_WriteCommand(0x02);
#endif

	SSD1306_WriteCommand(SSD1306_SET_CONTRAST);				// set contrast control register
#ifdef SSD1306_128X64
#if SSD1306_EXTERNAL == 1
	SSD1306_WriteCommand(0x9F);
#else
	SSD1306_WriteCommand(0xCF);
#endif
#else
	SSD1306_WriteCommand(0x8F);
#endif
	SSD1306_WriteCommand(SSD1306_SET_PRECHARGE);			// set pre-charge period
#if SSD1306_EXTERNAL == 1
	SSD1306_WriteCommand(0x22);
#else
	SSD1306_WriteCommand(0xF1);
#endif
	SSD1306_WriteCommand(0xF1);
	SSD1306_WriteCommand(SSD1306_SET_VCOM_DETECT);			// set vcomh
	SSD1306_WriteCommand(0x40);

	SSD1306_WriteCommand(SSD1306_DISPLAY_ALL_ON_RESUME);	// disable entire display on
	SSD1306_WriteCommand(SSD1306_NORMAL_DISPLAY);			// set normal display
	SSD1306_WriteCommand(SSD1306_DISPLAY_ON);				// turn on oled panel
}

// is there a better way ?
void SSD1306_Clear(void) {
	for(uint8_t page = 0 ; page < SSD1306_DISPLAY_HW_NOF_PAGES; page++) {
		SSD1306_SetPageStartAddr(page);
		SSD1306_SetColStartAddr(0);
		for(uint8_t col  = 0 ; col < SSD1306_DISPLAY_HW_NOF_COLUMNS ; col++) {
			SSD1306_WriteData(0x00);
		}
	}
	actPage = 0;
	actCol = 0;
}

void SSD1306_InvertDisplay(bool invert){
	if(invert) {
	  SSD1306_WriteCommand(SSD1306_INVERT_DISPLAY);
	} else {
	  SSD1306_WriteCommand(SSD1306_NORMAL_DISPLAY);
	}
}

void SSD1306_SetColStartAddr(uint8_t col){
	actCol = col;
	if(	actCol >= SSD1306_DISPLAY_HW_NOF_COLUMNS) {
	  return;
	}
	SSD1306_WriteCommand(0x10 | (	actCol>>4));
	SSD1306_WriteCommand(	actCol & 0x0F);
}

void SSD1306_SetPageStartAddr(uint8_t page) {
	actPage = page;
	if(actPage >= SSD1306_DISPLAY_HW_NOF_PAGES) {
	  return;
	}
	SSD1306_WriteCommand(0xB0 | actPage);
}

void SSD1306_PrintChar(uint8_t ch) {
	for(uint8_t i = 0; i<5; i++) {
		SSD1306_WriteData(font[((ch-0x20)*6)+i]);
	}
}

void SSD1306_PrintString(uint8_t *ch) {
	while(*ch != '\0'){
		if(*ch == '\n') {
			actPage++;
			if(actPage >= SSD1306_DISPLAY_HW_NOF_PAGES) {
			  actPage=0;
			}
			SSD1306_SetPageStartAddr(actPage);
			SSD1306_SetColStartAddr(0);
			ch++;
		} else {
		  SSD1306_PrintChar(*ch++);
		}
	}
}
