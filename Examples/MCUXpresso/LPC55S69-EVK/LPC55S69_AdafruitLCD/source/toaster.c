/*
 * Copyright (c) 2019, Erich Styger
 *
 * SPDX-License-Identifier: BSD-3-Clause
 *
 *****************************************
 * Idea and image files from Adafruit:
 * https://learn.adafruit.com/animated-flying-toaster-oled-jewelry
 * Animated pendant for Adafruit Pro Trinket and SSD1306 OLED display,
 * inspired by the After Dark "Flying Toasters" screensaver.
 */

#include "platform.h"
#if PL_CONFIG_USE_TOASTER
#include "toaster.h"
#include <stdint.h>
#include <stdlib.h>
#include "McuUtility.h"
#include "McuArmTools.h"
#include "lv.h"

#include "McuGDisplaySSD1306.h"

static const uint8_t
 toastermask0[] = {
  0x00, 0x00, 0x00, 0x00, 0x00, 0x10, 0x00, 0x00,
  0x00, 0x20, 0x00, 0x00, 0x00, 0x88, 0x00, 0x00,
  0x00, 0x10, 0x00, 0x00, 0x00, 0x43, 0xF8, 0x00,
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  0x01, 0xB0, 0x00, 0x00, 0x00, 0x00, 0x00, 0x00 },
 toastermask1[] = {
  0x00, 0x00, 0x00, 0x00, 0x00, 0x00, 0x00, 0x00,
  0x00, 0x00, 0x00, 0x00, 0x00, 0x00, 0x00, 0x00,
  0x00, 0x00, 0x00, 0x00, 0x00, 0x43, 0xF8, 0x00,
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  0x01, 0xB0, 0x00, 0x00, 0x00, 0x00, 0x00, 0x00 },
 toastermask2[] = {
  0x00, 0x00, 0x00, 0x00, 0x00, 0x00, 0x00, 0x00,
  0x00, 0x00, 0x00, 0x00, 0x00, 0x00, 0x00, 0x00,
  0x00, 0x00, 0x00, 0x00, 0x00, 0x03, 0xF8, 0x00,
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  0x01, 0xB0, 0x00, 0x00, 0x00, 0x00, 0x00, 0x00 },
 toastmask[] = {
  0x00, 0x00, 0x00, 0x00, 0x00, 0x00, 0x00, 0x00,
  0x00, 0x00, 0x00, 0x00, 0x00, 0x00, 0x00, 0x00,
  0x00, 0x00, 0x00, 0x00, 0x00, 0x00, 0x00, 0x00,
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  0x00, 0x00, 0x00, 0x00, 0x00, 0x00, 0x00, 0x00 },
 toaster0[] = {
  0x00, 0x30, 0x00, 0x00, 0x00, 0xE8, 0x00, 0x00,
  0x01, 0xD8, 0x00, 0x00, 0x03, 0x74, 0xF0, 0x00,
  0x07, 0xEF, 0xFE, 0x00, 0x07, 0xBC, 0x07, 0x80,
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  0x06, 0x4E, 0x00, 0x00, 0x01, 0xF0, 0x00, 0x00 },
 toaster1[] = {
  0x00, 0x00, 0x00, 0x00, 0x00, 0x00, 0x00, 0x00,
  0x00, 0x00, 0x00, 0x00, 0x00, 0x30, 0xF0, 0x00,
  0x00, 0xF7, 0xFE, 0x00, 0x01, 0xBC, 0x07, 0x80,
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  0x06, 0x4E, 0x00, 0x00, 0x01, 0xF0, 0x00, 0x00 },
 toaster2[] = {
  0x00, 0x00, 0x00, 0x00, 0x00, 0x00, 0x00, 0x00,
  0x00, 0x00, 0x00, 0x00, 0x00, 0x00, 0xF0, 0x00,
  0x00, 0x07, 0xFE, 0x00, 0x00, 0x3C, 0x07, 0x80,
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  0x06, 0x4E, 0x00, 0x00, 0x01, 0xF0, 0x00, 0x00 },
 toast[] = {
  0x00, 0x00, 0x00, 0x00, 0x00, 0x00, 0x00, 0x00,
  0x00, 0x00, 0x00, 0x00, 0x00, 0x00, 0x00, 0x00,
  0x00, 0x00, 0x00, 0x00, 0x00, 0x00, 0x00, 0x00,
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  0x00, 0x00, 0x00, 0x00, 0x00, 0x00, 0x00, 0x00 };

static const uint8_t* const mask[] = {
  toastermask0, toastermask1, toastermask2, toastermask1, toastmask };
static const uint8_t* const img[]  = {
  toaster0    , toaster1    , toaster2    , toaster1    , toast     };

#define N_FLYERS   3 // Number of flying things

struct Flyer {       // Array of flying things
  int16_t x, y;      // Top-left position * 16 (for subpixel pos updates)
  int8_t  depth;     // Stacking order is also speed, 12-24 subpixels/frame
  uint8_t frame;     // Animation frame; Toasters cycle 0-3, Toast=255
} flyer[N_FLYERS];

// Flyer depth comparison function for qsort()
static int compare(const void *a, const void *b) {
  return ((struct Flyer *)a)->depth - ((struct Flyer *)b)->depth;
}

static void drawBitmap(McuGDisplaySSD1306_PixelDim x, McuGDisplaySSD1306_PixelDim y, const uint8_t *bitmap, McuGDisplaySSD1306_PixelDim w, McuGDisplaySSD1306_PixelDim h, McuGDisplaySSD1306_PixelColor color) {
  TIMAGE image;

  image.name = "";
  image.width = w;
  image.height = h;
  image.size = w*h;
  image.pixmap = bitmap;
  McuGDisplaySSD1306_DrawMonoBitmapMask(x, y, &image, color);
}

static void DisplayToasters(void) {
  uint8_t i, f;
  int16_t x, y;
  bool resort = false;     // By default, don't re-sort depths

  McuGDisplaySSD1306_UpdateFull();
  McuGDisplaySSD1306_Clear(); /* screen black */

  for(i=0; i<N_FLYERS; i++) { // For each flyer...
    // First draw each item...
    f = (flyer[i].frame == 255) ? 4 : (flyer[i].frame++ & 3); // Frame #
    x = flyer[i].x / 16;
    y = flyer[i].y / 16;
    drawBitmap(x, y, mask[f], 32, 32, McuGDisplaySSD1306_COLOR_BLACK);
    drawBitmap(x, y, img[ f], 32, 32, McuGDisplaySSD1306_COLOR_WHITE);

    // Then update position, checking if item moved off screen...
    flyer[i].x -= flyer[i].depth * 2; // Update position based on depth,
    flyer[i].y += flyer[i].depth;     // for a sort of pseudo-parallax effect.
    if((flyer[i].y >= (64*16)) || (flyer[i].x <= (-32*16))) { // Off screen?
      if(McuUtility_random(0, 7-1) < 5) {         // Pick random edge; 0-4 = top
        flyer[i].x = McuUtility_random(0, 160-1) * 16;
        flyer[i].y = -32         * 16;
      } else {                    // 5-6 = right
        flyer[i].x = 128         * 16;
        flyer[i].y = McuUtility_random(0, 64-1)  * 16;
      }
      flyer[i].frame = McuUtility_random(0, 3-1) ? McuUtility_random(0, 4-1) : 255; // 66% toaster, else toast
      flyer[i].depth = 10 + McuUtility_random(0, 16-1);
      resort = true;
    }
  }
  // If any items were 'rebooted' to new position, re-sort all depths
  if(resort) {
    qsort(flyer, N_FLYERS, sizeof(struct Flyer), compare);
  }
}

#define REFR_TIME_MS   (150) /* with I2C bit banging, it requires about 130 ms for a OLED refresh */
static lv_task_t *refr_task;
static lv_obj_t *win;
static bool screenSaverIsRunning = false;
static bool stopScreenSaver = false;

bool TOASTER_IsRunning(void) {
  return screenSaverIsRunning;
}

void TOASTER_StopScreenSaver(void) {
  stopScreenSaver = true;
}

static void refresh_task(struct _lv_task_t *param) {
  if (stopScreenSaver) {
    lv_obj_del(win);
    win = NULL;
    lv_task_del(refr_task);
    refr_task = NULL;
    screenSaverIsRunning = false;
  } else {
    screenSaverIsRunning = true;
#if 1
    DisplayToasters();
#elif 1
    static uint32_t cntr = 0;
    McuGDisplaySSD1306_PixelColor color;

    cntr++;
    if (cntr<20) {
      color = McuGDisplaySSD1306_COLOR_BLACK;
    } else if (cntr<40) {
      color = McuGDisplaySSD1306_COLOR_WHITE;
    } else {
      color = McuGDisplaySSD1306_COLOR_BLACK;
      cntr = 0;
    }
    McuGDisplaySSD1306_DrawLine(
        McuUtility_random(0, LV_HOR_RES-1), McuUtility_random(0, LV_VER_RES-1),
        McuUtility_random(0, LV_HOR_RES-1), McuUtility_random(0, LV_VER_RES-1),
        color);
    McuGDisplaySSD1306_UpdateFull();
#else
    line_points[0].x = McuUtility_random(0, 64);
    line_points[0].y = McuUtility_random(0, 64);
    line_points[1].x = McuUtility_random(0, 64);
    line_points[1].y = McuUtility_random(0, 64);
    lv_line_set_points(line1, line_points, 2);     /*Set the points*/
    lv_obj_align(line1, NULL, LV_ALIGN_IN_TOP_MID, 0, 20);
#endif
  }
}

void TOASTER_Show(void) {
  stopScreenSaver = false;
  screenSaverIsRunning = false;
  refr_task = lv_task_create(refresh_task, REFR_TIME_MS, LV_TASK_PRIO_LOW, NULL);

  win = lv_obj_create(lv_scr_act(), NULL);
  lv_obj_set_style(win, &lv_style_transp);
  lv_obj_set_size(win, LV_HOR_RES, LV_VER_RES);
}

void TOASTER_Init(void) {
  McuUtility_randomSetSeed(McuArmTools_GetCycleCounter());
  for(uint8_t i=0; i<N_FLYERS; i++) {  // Randomize initial flyer states
    flyer[i].x     = (-32 + McuUtility_random(0, 160-1)) * 16;
    flyer[i].y     = (-32 + McuUtility_random(0, 96-1)) * 16;
    flyer[i].frame = McuUtility_random(0, 3-1) ? McuUtility_random(0, 4-1) : 255; // 66% toaster, else toast
    flyer[i].depth = 10 + McuUtility_random(0, 16-1);             // Speed / stacking order
  }
  qsort(flyer, N_FLYERS, sizeof(struct Flyer), compare); // Sort depths
}

void TOASTER_Deinit(void) {}

#endif /* PL_CONFIG_USE_TOASTER */
